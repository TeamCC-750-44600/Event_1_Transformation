// IRremote - Version: Latest 
#include <IRremote.h>
#include <IRremoteInt.h>
#include <boarddefs.h>
#include <ir_Lego_PF_BitStreamEncoder.h>

// Servo - Version: Latest 
#include <Servo.h>
/*
The code for the Transformation
Uses a L298N and a computer fan, and a 12V battery pack
By Mckinley
*/
Servo myServo;
IRsend irsend;
const int in2=2;
const int in1=3;
const int enA=5;
const int sensor=6;
int isObstacle=HIGH;
boolean signUp=false;
boolean fanOn=false;

void setup() 
{
    pinMode(in2, OUTPUT);
    pinMode(in1, OUTPUT);
    pinMode(enA, OUTPUT);
    pinMode(sensor, INPUT);
    myServo.attach(16);
    myServo.write(40);
    Serial.begin(9600);
}

void loop() 
{
    isObstacle = digitalRead(sensor);//take a reading of the distance
    irsend.sendRC5(0xFFA25D, 9);
    if(isObstacle==LOW)
    {
      Serial.println("Sensed Something");
      irsend.sendRC5(FF9867);//SQUIGGLES SIGNAL!
    }
    while(isObstacle==LOW)
    {
      if(fanOn==false)
      {
        digitalWrite(in1, HIGH);//Turn the fan on
        analogWrite(enA, 255);
        Serial.println("Fan on");
        fanOn=true;
      }
      isObstacle = digitalRead(sensor);//take a reading of the distance
      if(signUp == false)
      {
        myServo.write(110);
        signUp=true;
      }
    }
    digitalWrite(in1, LOW);//Turn the fan off
    fanOn=false;
}
